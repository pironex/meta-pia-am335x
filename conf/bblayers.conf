## conf/bblayers.conf
```bitbake
# POKY_BBLAYERS_CONF_VERSION is increased each time build/conf/bblayers.conf
# changes incompatibly
POKY_BBLAYERS_CONF_VERSION = "2"

BBPATH = "${TOPDIR}"
BBFILES ?= ""

BBLAYERS ?= " \
  /home/projekte/oe/poky/meta \
  /home/projekte/oe/poky/meta-poky \
  /home/projekte/oe/poky/meta-yocto-bsp \
  /home/projekte/oe/poky/meta-openembedded/meta-oe \
  /home/projekte/oe/poky/meta-openembedded/meta-systemd \
  /home/projekte/oe/poky/meta-openembedded/meta-python \
  /home/projekte/oe/poky/meta-openembedded/meta-networking \
  /home/projekte/oe/poky/meta-openembedded/meta-webserver \
  /home/projekte/oe/poky/meta-ti \
  /home/projekte/oe/poky/meta-pia-am335x \
  /home/projekte/oe/poky/meta-qt5 \
  /home/projekte/oe/poky/meta-qt4 \
"
```

## conf/layer.conf
```bitbake
# We have a conf and classes directory, append to BBPATH
BBPATH .= ":${LAYERDIR}"

# We have a recipes directory, add to BBFILES
BBFILES += "${LAYERDIR}/recipes*/*/*.bb ${LAYERDIR}/recipes*/*/*.bbappend"

BBFILE_COLLECTIONS += "pia-am335x-layer"
BBFILE_PATTERN_pia-am335x-layer := "^${LAYERDIR}/"
BBFILE_PRIORITY_pia-an335x-layer = "8"
```

## conf/machine/pia-am335x-apc.conf
```bitbake
#@TYPE: Machine
#@NAME: piA-AM335x-APC
#@DESCRIPTION: Machine configuration for the piA-AM335x-APC board

require pia335x.inc

# Only has DVI connector for external screen
#GUI_MACHINE_CLASS = "bigscreen"
#GUI_MACHINE_CLASS = "smallscreen"

# and sdio
# alsa removed for now
#MACHINE_FEATURES = "kernel26 alsa screen apm usbgadget usbhost vfat sgx touchscreen"
MACHINE_FEATURES += "ethernet can usbhost serial wifi bluetooth gsm ppp"

KERNEL_BRANCH = "pia335x-apc"
UBOOT_MACHINE = "am335x_pia_config"

MACHINE_ESSENTIAL_EXTRA_RRECOMMENDS += " kernel-module-cpsw kernel-module-8021q linux-firmware-wl12xx "

PREFERRED_PROVIDER_linux-firmware_wl12xx = "linux-firmware"
```

## conf/machine/pia-am335x-dr.conf
```bitbake
#@TYPE: Machine
#@NAME: piA-AM335x-DR
#@DESCRIPTION: Machine configuration for the piA-AM335x-APC board

require pia335x.inc

# Only has DVI connector for external screen
#GUI_MACHINE_CLASS = "bigscreen"
#GUI_MACHINE_CLASS = "smallscreen"

# and sdio
# alsa removed for now
#MACHINE_FEATURES = "kernel26 alsa screen apm usbgadget usbhost vfat sgx touchscreen"
MACHINE_FEATURES += "ethernet can usbhost serial wifi bluetooth gsm ppp"

KERNEL_BRANCH = "pia335x-4.4.y-dev"

MACHINE_ESSENTIAL_EXTRA_RDEPENDS = "kernel kernel-devicetree"
MACHINE_ESSENTIAL_EXTRA_RRECOMMENDS += " kernel-module-cpsw kernel-module-8021q linux-firmware-wl12xx kernel-module-musb-dsps"

#PREFERRED_PROVIDER_linux-firmware_wl12xx = "linux-firmware"
```

## conf/machine/pia-am335x-ebtft.conf
```bitbake
#@TYPE: Machine
#@NAME: piA-AM335x-EM
#@DESCRIPTION: Machine configuration for the LOKISA Energy Manager board

require pia-am335x.conf

# Only has DVI connector for external screen
#GUI_MACHINE_CLASS = "bigscreen"
GUI_MACHINE_CLASS = "smallscreen"

# and sdio
# alsa removed for now
#MACHINE_FEATURES = "kernel26 alsa screen apm usbgadget usbhost vfat sgx touchscreen"
MACHINE_FEATURES += "screen touchscreen"

KERNEL_BRANCH = "pia335x-em"
UBOOT_MACHINE = "am335x_pia_config"

MACHINE_ESSENTIAL_EXTRA_RRECOMMENDS += " kernel-module-cpsw kernel-module-8021q "
```

## conf/machine/pia-am335x-mmi.conf
```bitbake
#@TYPE: Machine
#@NAME: piA-AM335x machine
#@DESCRIPTION: Machine configuration for the pironex piA boards KM MMI

require pia335x.inc

# Only has DVI connector for external screen
#GUI_MACHINE_CLASS = "bigscreen"
GUI_MACHINE_CLASS = "smallscreen"

# and sdio
# alsa removed for now
#MACHINE_FEATURES = "kernel26 alsa screen apm usbgadget usbhost vfat sgx touchscreen"
MACHINE_FEATURES += "alsa screen touchscreen sgx ethernet can usbhost"

UBOOT_MACHINE = "am335x_pia_config"

MACHINE_ESSENTIAL_EXTRA_RRECOMMENDS += " kernel-module-cpsw kernel-module-8021q "
```

## conf/machine/pia-am335x.conf
```bitbake
#@TYPE: Machine
#@NAME: piA-AM335x machine
#@DESCRIPTION: Machine configuration for the pironex piA boards with AM335x CPU

require pia335x.inc

#GUI_MACHINE_CLASS = "bigscreen"
GUI_MACHINE_CLASS = "smallscreen"

# and sdio
# alsa removed for now
#MACHINE_FEATURES = "kernel26 alsa screen apm usbgadget usbhost vfat sgx touchscreen"
MACHINE_FEATURES += "ethernet can usbhost serial wifi bluetooth gsm ppp screen alsa sgx"

KERNEL_BRANCH = "pia335x-4.4.y-dev"

MACHINE_ESSENTIAL_EXTRA_RDEPENDS = "kernel kernel-devicetree"
#MACHINE_ESSENTIAL_EXTRA_RRECOMMENDS += " kernel-module-cpsw kernel-module-8021q linux-firmware-wl12xx kernel-module-musb-dsps"
MACHINE_ESSENTIAL_EXTRA_RRECOMMENDS += " kernel-modules"

#PREFERRED_PROVIDER_linux-firmware_wl12xx = "linux-firmware"
```

## conf/machine/pia-am335x_e2.conf
```bitbake
#@TYPE: Machine
#@NAME: piA-AM335x machine
#@DESCRIPTION: Machine configuration for the pironex piA boards KM E2

require pia335x.inc

# Only has DVI connector for external screen
#GUI_MACHINE_CLASS = "bigscreen"
GUI_MACHINE_CLASS = "smallscreen"

# and sdio
# alsa removed for now
#MACHINE_FEATURES = "kernel26 alsa screen apm usbgadget usbhost vfat sgx touchscreen"
# TODO doesn't have a screen but build qt anyyway
MACHINE_FEATURES += " usbhost vfat can "
DEFAULTTUNE_pia-am335x_e2 = "${DEFAULTTUNE_genericarmv7a}"


PREFERRED_PROVIDER_virtual/kernel = "linux-am335x-psp"

UBOOT_MACHINE = "am335x_pia_e2_config"

MACHINE_ESSENTIAL_EXTRA_RRECOMMENDS += " kernel-module-cpsw kernel-module-8021q "
```

## conf/machine/pia-am335x_mmi.conf
```bitbake
#@TYPE: Machine
#@NAME: piA-AM335x machine
#@DESCRIPTION: Machine configuration for the pironex piA boards KM MMI

require pia335x.inc

# Only has DVI connector for external screen
#GUI_MACHINE_CLASS = "bigscreen"
GUI_MACHINE_CLASS = "smallscreen"

# and sdio
# alsa removed for now
#MACHINE_FEATURES = "kernel26 alsa screen apm usbgadget usbhost vfat sgx touchscreen"
MACHINE_FEATURES += "alsa screen touchscreen sgx"
DEFAULTTUNE_pia-am335x_mmi = "${DEFAULTTUNE_genericarmv7a}"

PREFERRED_PROVIDER_virtual/kernel = "linux-am335x-psp"

UBOOT_MACHINE = "am335x_pia_mmi_config"

MACHINE_ESSENTIAL_EXTRA_RRECOMMENDS += " kernel-module-cpsw kernel-module-8021q "
```

## conf/machine/pia-am35x.conf
```bitbake
#@TYPE: Machine
#@NAME: piA-AM35x 
#@DESCRIPTION: Machine configuration for the pironex piA-AM35x boards

require conf/machine/include/omap3.inc

# Use built-in LCD by default
XSERVER += "xserver-xorg \
           xf86-input-evdev \
           xf86-video-fbdev \
           xf86-input-tslib"
GUI_MACHINE_CLASS = "smallscreen"

#MACHINE_FEATURES += "touchscreen ethernet can wifi bluetooth gsm"
MACHINE_FEATURES += "touchscreen ethernet can gsm"
#DEFAULTTUNE_pia-am35x = "${DEFAULTTUNE_genericarmv7a}"

SERIAL_CONSOLE = "115200 ttyO2"
USE_VT = "2"

IMAGE_FSTYPES += "ubi tar.gz"
EXTRA_IMAGECMD_jffs2 = "-lnp -e 0x20000 -s 2048"

PREFERRED_PROVIDER_virtual/kernel = "linux-omap-psp"

PREFERRED_PROVIDER_virtual/bootloader = "u-boot-pia35x"
PREFERRED_PROVIDER_u-boot = "u-boot-pia35x"

UBOOT_MACHINE = "am35x_pia_config"
XLOAD_MACHINE = "am35x_pia_config"

# do ubiattach /dev/ubi_ctrl -m 4
# From dmesg:
# UBI: smallest flash I/O unit:    2048
# UBI: logical eraseblock size:    129024 bytes
# from ubiattach stdout:
# UBI device number 0, total 1996 LEBs
MKUBIFS_ARGS = "-m 2048 -e 129024 -c 1996"

# do ubiattach /dev/ubi_ctrl -m 4
# from dmesg:
# UBI: smallest flash I/O unit:    2048
# UBI: physical eraseblock size:   131072 bytes (128 KiB)
# UBI: sub-page size:              512
UBINIZE_ARGS = "-m 2048 -p 128KiB -s 512"

PIA_QT_PROVIDER = "${@base_contains('MACHINE_FEATURES','sgx','qt4-embedded-gles','qt4-embedded',d)}"
PREFERRED_PROVIDER_qt4-embedded = "${PIA_QT_PROVIDER}"
PREFERRED_PROVIDER_libqwt-dev = "qwt-e"

PREFERRED_VERSION_qt4-embedded = "4.8.5"
PREFERRED_VERSION_qt4-native = "4.8.5"
PREFERRED_VERSION_nativesdk-qt4-tools = "4.8.5"

PREFERRED_PROVIDER_virtual/libgl = "mesa-gl"
PREFERRED_PROVIDER_virtual/egl = "libgles-omap3"
PREFERRED_PROVIDER_virtual/libgles1 = "libgles-omap3"
PREFERRED_PROVIDER_virtual/libgles2 = "libgles-omap3"
PREFERRED_PROVIDER_virtual/mesa = "mesa-gl"
PREFERRED_VERSION_omap3-sgx-modules = "5.01.00.01"
PREFERRED_VERSION_libgles-omap3 = "5.01.00.01"

PREFERRED_PROVIDER_mysql5 = "mariadb"
PREFERRED_PROVIDER_mysql5-native = "mariadb-native"
PREFERRED_PROVIDER_mysql5-client = "mariadb"
PREFERRED_PROVIDER_mysql5-server = "mariadb"

PREFERRED_PROVIDER_wl12xx-firmware = "wl12xx-firmware"
PREFERRED_PROVIDER_wpa-supplicant = "wpa-supplicant"
```

## conf/machine/pia335x.inc
```bitbake
# common machine settings for AM335x based boards
require conf/machine/include/ti33x.inc

PREFERRED_PROVIDER_virtual/xserver = "xserver-xorg"
XSERVER = "xserver-xorg \
           xf86-input-evdev \
           xf86-video-fbdev \
           xf86-input-tslib "

#MACHINE_FEATURES = "kernel26 apm usbgadget usbhost vfat ext2 screen alsa ethernet sgx"
# override ti33x features as we don't support SGX, ALSA, USB, Screen on every board
MACHINE_FEATURES = "kernel26 apm vfat ext2 ethernet "

EXTRA_IMAGEDEPENDS += "u-boot"

PREFERRED_PROVIDER_virtual/kernel = "linux-ti-staging"
PREFERRED_PROVIDER_virtual/bootloader = "u-boot-pia"
PREFERRED_PROVIDER_u-boot = "u-boot-pia"

KERNEL_IMAGETYPE = "zImage"

UBOOT_ARCH = "arm"
UBOOT_MACHINE = "am335x_pia_defconfig"

IMAGE_FSTYPES += "tar.xz"

# Guesswork
SERIAL_CONSOLE = "115200 ttyO0"
```
